## boards/shields/bastardkb/Kconfig.defconfig
```kconfig
if BASTARDKB_LEFT
config ZMK_KEYBOARD_NAME
    default "bastardkb"

config ZMK_SPLIT_ROLE_CENTRAL
    default y

endif

if SHIELD_MY_BOARD_LEFT || SHIELD_MY_BOARD_RIGHT

config ZMK_SPLIT
    default y

endif
  
```

## config/boards/shields/bastardkb/Kconfig.defconfig
```kconfig
if SHIELD_BASTARDKB_LEFT
# if SHIELD_BASTARDKB_RIGHT
config ZMK_KEYBOARD_NAME
    default "bastardkb_auryn"

config ZMK_SPLIT_ROLE_CENTRAL
    default y

config ZMK_USB
	default y

endif

if SHIELD_BASTARDKB_LEFT || SHIELD_BASTARDKB_RIGHT

config ZMK_SPLIT
    default y

endif
  
```

## config/boards/shields/bastardkb/Kconfig.shield
```kconfig
config SHIELD_BASTARDKB_LEFT
  def_bool $(shields_list_contains,bastardkb_left)
config SHIELD_BASTARDKB_RIGHT
  def_bool $(shields_list_contains,bastardkb_right)
```
